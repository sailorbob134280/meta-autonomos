## meta-autonomos-beaglebone/conf/layer.conf
```bitbake
# We have a conf and classes directory, add to BBPATH
BBPATH .= ":${LAYERDIR}"

# We have recipes-* directories, add to BBFILES
BBFILES += "${LAYERDIR}/recipes-*/*/*.bb \
            ${LAYERDIR}/recipes-*/*/*.bbappend"

BBFILE_COLLECTIONS += "autonomos-beaglebone"
BBFILE_PATTERN_autonomos-beaglebone = "^${LAYERDIR}/"
BBFILE_PRIORITY_autonomos-beaglebone = "7"

LAYERDEPENDS_autonomos-beaglebone = " \
    autonomos-core \
    meta-ti-bsp"

LAYERSERIES_COMPAT_autonomos-beaglebone = "scarthgap"

# WIC files location
WKS_SEARCH_PATH:prepend = "${LAYERDIR}/wic:"
```

## meta-autonomos-core/conf/distro/autonomos.conf
```bitbake
# Start with a base Poky distro and go from there
require conf/distro/poky.conf

DISTRO = "autonomos"
DISTRO_NAME = "AutonomOS"
DISTRO_VERSION = "0.1"
DISTRO_CODENAME = "Rubik"

# Use standard image naming for RAUC bundle compatibility
# Bundle expects: ${IMAGE_BASENAME}${IMAGE_MACHINE_SUFFIX}${IMAGE_NAME_SUFFIX}.${fstype}
# e.g., autonomos-devel-raspberrypi5.rootfs.ext4
IMAGE_MACHINE_SUFFIX = "-${MACHINE}"
IMAGE_NAME_SUFFIX = ".rootfs"

# Use systemd over sysvinit (usrmerge required for systemd in scarthgap+)
DISTRO_FEATURES:append = " systemd usrmerge"
DISTRO_FEATURES_BACKFILL_CONSIDERED += "sysvinit"
VIRTUAL-RUNTIME_init_manager = "systemd"
VIRTUAL-RUNTIME_initscripts = "systemd-compat-units"
VIRTUAL-RUNTIME_network_manager = "networkd"

# Strip out unnecessary graphical support
DISTRO_FEATURES:remove = " x11 wayland"

# Use IPK package format
PACKAGE_CLASSES = "package_ipk"

# Require wifi
DISTRO_FEATURES:append = " wifi bluetooth"

# Support containerization
DISTRO_FEATURES:append = "${@bb.utils.contains('AUTONOMOS_FEATURES', 'containers', ' virtualization', '', d)}"
DISTRO_FEATURES:append = "${@bb.utils.contains('AUTONOMOS_FEATURES', 'kubernetes', ' k3s seccomp virtualization', '', d)}"

# Fix the command line if kubernetes is enabled
CMDLINE_ROOTFS:append = "${@bb.utils.contains('AUTONOMOS_FEATURES', 'kubernetes', ' cgroup_enable=cpuset cgroup_memory=1 cgroup_enable=memory ', '', d)}"

# RAUC OTA support
DISTRO_FEATURES:append = " rauc"
IMAGE_INSTALL:append = " rauc casync data-partition-resize"

# Set the C standard library to use
TCLIBC = "glibc"
```

## meta-autonomos-raspberrypi/conf/layer.conf
```bitbake
# We have a conf and classes directory, add to BBPATH
BBPATH .= ":${LAYERDIR}"

# We have recipes-* directories, add to BBFILES
BBFILES += "${LAYERDIR}/recipes-*/*/*.bb \
            ${LAYERDIR}/recipes-*/*/*.bbappend"

BBFILE_COLLECTIONS += "autonomos-raspberrypi"
BBFILE_PATTERN_autonomos-raspberrypi = "^${LAYERDIR}/"
BBFILE_PRIORITY_autonomos-raspberrypi = "7"

LAYERDEPENDS_autonomos-raspberrypi = " \
    autonomos-core \
    raspberrypi"

LAYERSERIES_COMPAT_autonomos-raspberrypi = "scarthgap"

# WIC files location
WKS_SEARCH_PATH:prepend = "${LAYERDIR}/wic:"
```
